## drivers/base/regmap/Kconfig
```kconfig
# Generic register map support.  There are no user servicable options here,
# this is an API intended to be used by other kernel subsystems.  These
# subsystems should select the appropriate symbols.

config REGMAP
	default y
	bool "Generic register map support"

config REGMAP_I2C
	tristate "regmap i2c support"
	depends on I2C
```

## drivers/staging/iio/imu/inv_mpu/Kconfig
```kconfig
#
# inv-mpu-iio driver for Invensense MPU devices and combos
#

config INV_MPU_IIO
	tristate "Invensense MPU9250 I2C driver"
	depends on I2C && SYSFS && IIO && IIO_KFIFO_BUF && IIO_TRIGGER && !INV_MPU
	default n
	help
	  This driver supports the Invensense MPU9250 device.
	  This driver can be built as a module. The module will be called
	  inv-mpu-iio.
```
